## Kconfig
```kconfig
#
# Touchscreen driver configuration
#
menuconfig INPUT_TOUCHSCREEN
	bool "Touchscreens"
	help
	  Say Y here, and a list of supported touchscreens will be displayed.
	  This option doesn't affect the kernel.

	  If unsure, say Y.

if INPUT_TOUCHSCREEN

# common

config TOUCHSCREEN_COMMON
	bool "Common touchscreen interface to interact with userspace"
	default n
	help
	  Say Y here if you want to control touchpanel features via
	  /sys/touchpanel.

	  If unsure, say N.

# ysl
source "drivers/input/touchscreen/ft5446_e6/Kconfig"
source "drivers/input/touchscreen/gt917d_e6/Kconfig"

endif
```

## ft5446_e6/Kconfig
```kconfig
#
# Focaltech Touchscreen driver configuration
#

config TOUCHSCREEN_FTS_MI8953
        bool "Focaltech Touchscreen"
		depends on I2C
		default n
		help
		  Say Y here if you have Focaltech touch panel.
		  If unsure, say N.

config TOUCHSCREEN_FTS_MI8953_DIRECTORY
    string "Focaltech ts directory name"
    default "ft5446_e6"
    depends on TOUCHSCREEN_GT917D_MI8953
```
